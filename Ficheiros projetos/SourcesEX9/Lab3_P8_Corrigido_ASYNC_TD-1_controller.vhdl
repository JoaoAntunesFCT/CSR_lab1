-- Net Lab3_P8_Corrigido_ASYNC_TD_2 - IOPT
-- Automatic code generated by IOPT2VHDL XSLT transformation.
-- by GRES Research Group - 2014 


Library IEEE;
Use IEEE.STD_LOGIC_1164.ALL;
Use IEEE.STD_LOGIC_ARITH.ALL;
Use IEEE.STD_LOGIC_UNSIGNED.ALL;


Entity Lab3_P8_Corrigido_ASYNC_TD_2 IS
Port(
    Clk : IN STD_LOGIC;
    in1 : IN STD_LOGIC;
    outi : IN STD_LOGIC;
    event_event104_td_1 : IN STD_LOGIC;
    movei : OUT STD_LOGIC;
    Bot1 : OUT STD_LOGIC;
    Pecas1 : OUT INTEGER RANGE 0 TO 3;
    out_evt_event101_td_2 : OUT STD_LOGIC;
    Enable : IN STD_LOGIC;
    Reset : IN STD_LOGIC
);
End Lab3_P8_Corrigido_ASYNC_TD_2;

Architecture Structural OF Lab3_P8_Corrigido_ASYNC_TD_2 IS

    Signal p_4: INTEGER RANGE 0 TO 3 := 0;
    Signal p_5: INTEGER RANGE 0 TO 3 := 1;
    Signal p_6: INTEGER RANGE 0 TO 3 := 0;
    Signal p_43: INTEGER RANGE 0 TO 3 := 3;
    Signal p_46: INTEGER RANGE 0 TO 3 := 0;
    Signal p_69: INTEGER RANGE 0 TO 3 := 0;
    Signal p_72: INTEGER RANGE 0 TO 1 := 0;
    Signal p_74: INTEGER RANGE 0 TO 1 := 1;

    Signal prev_in1: STD_LOGIC := '0';
    Signal prev_outi: STD_LOGIC := '0';

    Signal event_outi: STD_LOGIC := '0';
    Signal event_in1: STD_LOGIC := '0';

    Signal s_movei : STD_LOGIC := '0';
    Signal s_Bot1 : STD_LOGIC := '0';
    Signal s_Pecas1 : INTEGER RANGE 0 TO 3 := 0;

    -- Array implementation:

Begin
    -- Selected array items:

    proc_in_events: PROCESS( Clk, Enable ) IS
    Begin
      If falling_edge(Clk) Then
        If Reset = '0' AND Enable = '1' Then
          If (prev_outi = '0') and (outi = '1')
            Then event_outi <= '1';
            Else event_outi <= '0';
          End If;
          If (prev_in1 = '0') and (in1 = '1')
            Then event_in1 <= '1';
            Else event_in1 <= '0';
          End If;
        End If;
        prev_in1 <= in1;
        prev_outi <= outi;
      End If;
    End PROCESS;


    proc_transitions: PROCESS( Clk, Enable, Reset ) IS
      Variable p_4_add, p_4_avail : INTEGER RANGE 0 to 3;
      Variable p_5_add, p_5_avail : INTEGER RANGE 0 to 3;
      Variable p_6_add, p_6_avail : INTEGER RANGE 0 to 3;
      Variable p_43_add, p_43_avail : INTEGER RANGE 0 to 3;
      Variable p_46_add, p_46_avail : INTEGER RANGE 0 to 3;
      Variable p_69_add, p_69_avail : INTEGER RANGE 0 to 3;
      Variable p_72_add, p_72_avail : INTEGER RANGE 0 to 1;
      Variable p_74_add, p_74_avail : INTEGER RANGE 0 to 1;
    Begin
      If Reset = '1' Then
          p_4 <= 0;
          p_5 <= 1;
          p_6 <= 0;
          p_43 <= 3;
          p_46 <= 0;
          p_69 <= 0;
          p_72 <= 0;
          p_74 <= 1;
      Elsif rising_edge(Clk) Then
        If Enable = '1' Then
          p_4_avail := p_4;
          p_4_add := 0;   -- pl_4;
          p_5_avail := p_5;
          p_5_add := 0;   -- pl_5;
          p_6_avail := p_6;
          p_6_add := 0;   -- Processar Peca;
          p_43_avail := p_43;
          p_43_add := 0;   -- Pecas;
          p_46_avail := p_46;
          p_46_add := 0;   -- Buffer;
          p_69_avail := p_69;
          p_69_add := 0;   -- Move;
          p_72_avail := p_72;
          p_72_add := 0;   -- Parado & Ocupado;
          p_74_avail := p_74;
          p_74_add := 0;   -- Parado & Livre;

          out_evt_event101_td_2 <= '0';

          -- Transition 10 - OUT1
          If (p_69_avail >= 1) and 
             (conv_integer(outi) = 1) -- guard expr 
          Then
              p_69_avail := p_69_avail - 1;    -- Move
              p_4_add := p_4_add + 1;   -- pl_4
              p_72_add := p_72_add + 1;   -- Parado & Ocupado
          End If;

          -- Transition 11 - tr_11
          If (p_4_avail >= 1) and
             (p_5_avail >= 1) and 
             (conv_integer(outi) = 1) -- guard expr 
          Then
              p_4_avail := p_4_avail - 1;    -- pl_4
              p_5_avail := p_5_avail - 1;    -- pl_5
              p_6_add := p_6_add + 1;   -- Processar Peca
          End If;

          -- Transition 12 - tr_12
          If (p_6_avail >= 1) and
             (p_72_avail >= 1) and 
             (conv_integer(outi) = 0) -- guard expr 
          Then
              p_6_avail := p_6_avail - 1;    -- Processar Peca
              p_72_avail := p_72_avail - 1;    -- Parado & Ocupado
              p_43_add := p_43_add + 1;   -- Pecas
              p_74_add := p_74_add + 1;   -- Parado & Livre
              out_evt_event101_td_2 <= '1';
          End If;

          -- Transition 39 - tr_1
          If (p_43_avail >= 1) and
             (event_in1 = '1')
          Then
              p_43_avail := p_43_avail - 1;    -- Pecas
              p_46_add := p_46_add + 1;   -- Buffer
          End If;

          -- Transition 67 - tr_2
          If (p_46_avail >= 1) and
             (p_74_avail >= 1)
          Then
              p_46_avail := p_46_avail - 1;    -- Buffer
              p_74_avail := p_74_avail - 1;    -- Parado & Livre
              p_69_add := p_69_add + 1;   -- Move
          End If;

          -- Transition 99 - tr_67_21
          If TRUE and
             (event_event104_td_1 = '1')
          Then
              p_5_add := p_5_add + 1;   -- pl_5
          End If;

          -- Calculate final place marking:
          p_4 <= p_4_avail + p_4_add;
          p_5 <= p_5_avail + p_5_add;
          p_6 <= p_6_avail + p_6_add;
          p_43 <= p_43_avail + p_43_add;
          p_46 <= p_46_avail + p_46_add;
          p_69 <= p_69_avail + p_69_add;
          p_72 <= p_72_avail + p_72_add;
          p_74 <= p_74_avail + p_74_add;

          -- Apply output events to ouput signals:

          -- Calculate transition-action-output final values:
        End If;
      End If;
    End PROCESS;


    proc_place_outputs: PROCESS( Clk, Enable ) IS
    Variable exp_res, new_value: Integer;
    Begin
      If rising_edge(Clk) Then
        If Reset='1' Then
          s_movei <= '0';
          s_Pecas1 <= 0;

        Elsif Enable='1' Then

          -- Signal movei default value:
          new_value := 0;

          -- movei action on place Move(p_69)
          If p_69 > 0 Then
            exp_res := 1;
            If (TRUE)
              Then new_value := exp_res;
            End If;
          End If;

          -- Store movei and check result range:
          If new_value < 0 Then s_movei <= '0';
            Elsif new_value > 1 Then s_movei <= '1';
            Else s_movei <= conv_std_logic_vector(new_value,1)(0);
          End If;

          -- Signal Pecas1 default value:
          new_value := 0;

          -- Pecas1 action on place Pecas(p_43)
          If p_43 > 0 Then
            exp_res := 3 - p_43;
            If (TRUE)
              Then new_value := exp_res;
            End If;
          End If;

          -- Store Pecas1 and check result range:
          If new_value < 0 Then s_Pecas1 <= 0;
            Elsif new_value > 3 Then s_Pecas1 <= 3;
            Else s_Pecas1 <= new_value;
          End If;

        End If;
      End If;
    End PROCESS;

    movei <= s_movei;
    Bot1 <= s_Bot1;
    Pecas1 <= s_Pecas1;

End Structural;
