-- Net Lab3_P8_Corrigido_ASYNC_TD_3 - IOPT
-- Automatic code generated by IOPT2VHDL XSLT transformation.
-- by GRES Research Group - 2014 


Library IEEE;
Use IEEE.STD_LOGIC_1164.ALL;
Use IEEE.STD_LOGIC_ARITH.ALL;
Use IEEE.STD_LOGIC_UNSIGNED.ALL;


Entity Lab3_P8_Corrigido_ASYNC_TD_3 IS
Port(
    Clk : IN STD_LOGIC;
    ini_2 : IN STD_LOGIC;
    outi_3 : IN STD_LOGIC;
    ini_3 : IN STD_LOGIC;
    event_event120_td_3 : IN STD_LOGIC;
    Bot2 : OUT STD_LOGIC;
    movei_3 : OUT STD_LOGIC;
    Bot3 : OUT STD_LOGIC;
    Pecas3 : OUT INTEGER RANGE 0 TO 3;
    out_evt_event123_td_2 : OUT STD_LOGIC;
    Enable : IN STD_LOGIC;
    Reset : IN STD_LOGIC
);
End Lab3_P8_Corrigido_ASYNC_TD_3;

Architecture Structural OF Lab3_P8_Corrigido_ASYNC_TD_3 IS

    Signal p_36_9: INTEGER RANGE 0 TO 3 := 0;
    Signal p_61: INTEGER RANGE 0 TO 3 := 1;
    Signal p_89_8: INTEGER RANGE 0 TO 3 := 0;
    Signal p_90_4: INTEGER RANGE 0 TO 3 := 0;
    Signal p_90_6: INTEGER RANGE 0 TO 3 := 0;
    Signal p_90_8: INTEGER RANGE 0 TO 3 := 0;
    Signal p_90_43: INTEGER RANGE 0 TO 3 := 3;
    Signal p_90_46: INTEGER RANGE 0 TO 3 := 0;
    Signal p_90_69: INTEGER RANGE 0 TO 3 := 0;
    Signal p_90_72: INTEGER RANGE 0 TO 1 := 0;
    Signal p_90_74: INTEGER RANGE 0 TO 1 := 1;
    Signal p_90_78: INTEGER RANGE 0 TO 3 := 1;

    Signal prev_ini_2: STD_LOGIC := '0';
    Signal prev_outi_3: STD_LOGIC := '0';

    Signal event_ini_2: STD_LOGIC := '0';
    Signal event_outi_3: STD_LOGIC := '0';

    Signal s_Bot2 : STD_LOGIC := '0';
    Signal s_movei_3 : STD_LOGIC := '0';
    Signal s_Bot3 : STD_LOGIC := '0';
    Signal s_Pecas3 : INTEGER RANGE 0 TO 3 := 0;

    -- Array implementation:

Begin
    -- Selected array items:

    proc_in_events: PROCESS( Clk, Enable ) IS
    Begin
      If falling_edge(Clk) Then
        If Reset = '0' AND Enable = '1' Then
          If (prev_ini_2 = '0') and (ini_2 = '1')
            Then event_ini_2 <= '1';
            Else event_ini_2 <= '0';
          End If;
          If (prev_outi_3 = '0') and (outi_3 = '1')
            Then event_outi_3 <= '1';
            Else event_outi_3 <= '0';
          End If;
        End If;
        prev_ini_2 <= ini_2;
        prev_outi_3 <= outi_3;
      End If;
    End PROCESS;


    proc_transitions: PROCESS( Clk, Enable, Reset ) IS
      Variable p_36_9_add, p_36_9_avail : INTEGER RANGE 0 to 3;
      Variable p_61_add, p_61_avail : INTEGER RANGE 0 to 3;
      Variable p_89_8_add, p_89_8_avail : INTEGER RANGE 0 to 3;
      Variable p_90_4_add, p_90_4_avail : INTEGER RANGE 0 to 3;
      Variable p_90_6_add, p_90_6_avail : INTEGER RANGE 0 to 3;
      Variable p_90_8_add, p_90_8_avail : INTEGER RANGE 0 to 3;
      Variable p_90_43_add, p_90_43_avail : INTEGER RANGE 0 to 3;
      Variable p_90_46_add, p_90_46_avail : INTEGER RANGE 0 to 3;
      Variable p_90_69_add, p_90_69_avail : INTEGER RANGE 0 to 3;
      Variable p_90_72_add, p_90_72_avail : INTEGER RANGE 0 to 1;
      Variable p_90_74_add, p_90_74_avail : INTEGER RANGE 0 to 1;
      Variable p_90_78_add, p_90_78_avail : INTEGER RANGE 0 to 3;
    Begin
      If Reset = '1' Then
          p_36_9 <= 0;
          p_61 <= 1;
          p_89_8 <= 0;
          p_90_4 <= 0;
          p_90_6 <= 0;
          p_90_8 <= 0;
          p_90_43 <= 3;
          p_90_46 <= 0;
          p_90_69 <= 0;
          p_90_72 <= 0;
          p_90_74 <= 1;
          p_90_78 <= 1;
      Elsif rising_edge(Clk) Then
        If Enable = '1' Then
          p_36_9_avail := p_36_9;
          p_36_9_add := 0;   -- pl_9_3;
          p_61_avail := p_61;
          p_61_add := 0;   -- ppb_3;
          p_89_8_avail := p_89_8;
          p_89_8_add := 0;   -- pl_8_4;
          p_90_4_avail := p_90_4;
          p_90_4_add := 0;   -- pl_4_5;
          p_90_6_avail := p_90_6;
          p_90_6_add := 0;   -- Processar Peca_3;
          p_90_8_avail := p_90_8;
          p_90_8_add := 0;   -- pl_8_5;
          p_90_43_avail := p_90_43;
          p_90_43_add := 0;   -- Pecas3;
          p_90_46_avail := p_90_46;
          p_90_46_add := 0;   -- Buffer_3;
          p_90_69_avail := p_90_69;
          p_90_69_add := 0;   -- Move_3;
          p_90_72_avail := p_90_72;
          p_90_72_add := 0;   -- Parado & Ocupado_3;
          p_90_74_avail := p_90_74;
          p_90_74_add := 0;   -- Parado & Livre_3;
          p_90_78_avail := p_90_78;
          p_90_78_add := 0;   -- pl_78_3;

          out_evt_event123_td_2 <= '0';

          -- Transition 36_13 - tr_13_3
          If (p_61_avail >= 1) and
             (p_90_8_avail >= 1) and 
             (conv_integer(ini_3) = 1) -- guard expr 
          Then
              p_61_avail := p_61_avail - 1;    -- ppb_3
              p_90_8_avail := p_90_8_avail - 1;    -- pl_8_5
              p_36_9_add := p_36_9_add + 1;   -- pl_9_3
          End If;

          -- Transition 36_25 - tr_25_3
          If (p_36_9_avail >= 1) and 
             (conv_integer(ini_3) = 1) -- guard expr 
          Then
              p_36_9_avail := p_36_9_avail - 1;    -- pl_9_3
              p_61_add := p_61_add + 1;   -- ppb_3
              p_90_78_add := p_90_78_add + 1;   -- pl_78_3
          End If;

          -- Transition 90_10 - OUT1_3
          If (p_90_69_avail >= 1) and
             (event_outi_3 = '1') and 
             (conv_integer(outi_3) = 1) -- guard expr 
          Then
              p_90_69_avail := p_90_69_avail - 1;    -- Move_3
              p_90_4_add := p_90_4_add + 1;   -- pl_4_5
              p_90_72_add := p_90_72_add + 1;   -- Parado & Ocupado_3
          End If;

          -- Transition 90_11 - tr_11_5
          If (p_90_4_avail >= 1) and
             (p_90_78_avail >= 1) and 
             (conv_integer(outi_3) = 1) -- guard expr 
          Then
              p_90_4_avail := p_90_4_avail - 1;    -- pl_4_5
              p_90_78_avail := p_90_78_avail - 1;    -- pl_78_3
              p_90_6_add := p_90_6_add + 1;   -- Processar Peca_3
          End If;

          -- Transition 90_12 - tr_12_5
          If (p_90_6_avail >= 1) and
             (p_90_72_avail >= 1) and 
             (conv_integer(outi_3) = 0) -- guard expr 
          Then
              p_90_6_avail := p_90_6_avail - 1;    -- Processar Peca_3
              p_90_72_avail := p_90_72_avail - 1;    -- Parado & Ocupado_3
              p_90_8_add := p_90_8_add + 1;   -- pl_8_5
              p_90_43_add := p_90_43_add + 1;   -- Pecas3
              p_90_74_add := p_90_74_add + 1;   -- Parado & Livre_3
          End If;

          -- Transition 90_39 - tr_39_3
          If (p_90_43_avail >= 1) and
             (p_89_8_avail >= 1) and
             (event_ini_2 = '1')
          Then
              p_90_43_avail := p_90_43_avail - 1;    -- Pecas3
              p_89_8_avail := p_89_8_avail - 1;    -- pl_8_4
              p_90_46_add := p_90_46_add + 1;   -- Buffer_3
          End If;

          -- Transition 90_67 - tr_67_3
          If (p_90_46_avail >= 1) and
             (p_90_74_avail >= 1)
          Then
              p_90_46_avail := p_90_46_avail - 1;    -- Buffer_3
              p_90_74_avail := p_90_74_avail - 1;    -- Parado & Livre_3
              p_90_69_add := p_90_69_add + 1;   -- Move_3
              out_evt_event123_td_2 <= '1';
          End If;

          -- Transition 117 - tr_12_41
          If TRUE and
             (event_event120_td_3 = '1')
          Then
              p_89_8_add := p_89_8_add + 1;   -- pl_8_4
          End If;

          -- Calculate final place marking:
          p_36_9 <= p_36_9_avail + p_36_9_add;
          p_61 <= p_61_avail + p_61_add;
          p_89_8 <= p_89_8_avail + p_89_8_add;
          p_90_4 <= p_90_4_avail + p_90_4_add;
          p_90_6 <= p_90_6_avail + p_90_6_add;
          p_90_8 <= p_90_8_avail + p_90_8_add;
          p_90_43 <= p_90_43_avail + p_90_43_add;
          p_90_46 <= p_90_46_avail + p_90_46_add;
          p_90_69 <= p_90_69_avail + p_90_69_add;
          p_90_72 <= p_90_72_avail + p_90_72_add;
          p_90_74 <= p_90_74_avail + p_90_74_add;
          p_90_78 <= p_90_78_avail + p_90_78_add;

          -- Apply output events to ouput signals:

          -- Calculate transition-action-output final values:
        End If;
      End If;
    End PROCESS;


    proc_place_outputs: PROCESS( Clk, Enable ) IS
    Variable exp_res, new_value: Integer;
    Begin
      If rising_edge(Clk) Then
        If Reset='1' Then
          s_Bot2 <= '0';
          s_movei_3 <= '0';
          s_Bot3 <= '0';
          s_Pecas3 <= 0;

        Elsif Enable='1' Then

          -- Signal Bot2 default value:
          new_value := 0;

          -- Bot2 action on place pl_8_4(p_89_8)
          If p_89_8 > 0 Then
            exp_res := 1;
            If (TRUE)
              Then new_value := exp_res;
            End If;
          End If;

          -- Store Bot2 and check result range:
          If new_value < 0 Then s_Bot2 <= '0';
            Elsif new_value > 1 Then s_Bot2 <= '1';
            Else s_Bot2 <= conv_std_logic_vector(new_value,1)(0);
          End If;

          -- Signal movei_3 default value:
          new_value := 0;

          -- movei_3 action on place Move_3(p_90_69)
          If p_90_69 > 0 Then
            exp_res := 1;
            If (TRUE)
              Then new_value := exp_res;
            End If;
          End If;

          -- Store movei_3 and check result range:
          If new_value < 0 Then s_movei_3 <= '0';
            Elsif new_value > 1 Then s_movei_3 <= '1';
            Else s_movei_3 <= conv_std_logic_vector(new_value,1)(0);
          End If;

          -- Signal Bot3 default value:
          new_value := 0;

          -- Bot3 action on place pl_8_5(p_90_8)
          If p_90_8 > 0 Then
            exp_res := 1;
            If (TRUE)
              Then new_value := exp_res;
            End If;
          End If;

          -- Store Bot3 and check result range:
          If new_value < 0 Then s_Bot3 <= '0';
            Elsif new_value > 1 Then s_Bot3 <= '1';
            Else s_Bot3 <= conv_std_logic_vector(new_value,1)(0);
          End If;

          -- Signal Pecas3 default value:
          new_value := 0;

          -- Pecas3 action on place Pecas3(p_90_43)
          If p_90_43 > 0 Then
            exp_res := 3 - p_90_43;
            If (TRUE)
              Then new_value := exp_res;
            End If;
          End If;

          -- Store Pecas3 and check result range:
          If new_value < 0 Then s_Pecas3 <= 0;
            Elsif new_value > 3 Then s_Pecas3 <= 3;
            Else s_Pecas3 <= new_value;
          End If;

        End If;
      End If;
    End PROCESS;

    Bot2 <= s_Bot2;
    movei_3 <= s_movei_3;
    Bot3 <= s_Bot3;
    Pecas3 <= s_Pecas3;

End Structural;
