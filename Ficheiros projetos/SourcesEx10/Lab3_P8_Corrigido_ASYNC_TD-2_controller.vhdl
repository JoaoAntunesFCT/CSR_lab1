-- Net Lab3_P8_Corrigido_ASYNC_TD_2 - IOPT
-- Automatic code generated by IOPT2VHDL XSLT transformation.
-- by GRES Research Group - 2014 


Library IEEE;
Use IEEE.STD_LOGIC_1164.ALL;
Use IEEE.STD_LOGIC_ARITH.ALL;
Use IEEE.STD_LOGIC_UNSIGNED.ALL;


Entity Lab3_P8_Corrigido_ASYNC_TD_2 IS
Port(
    Clk : IN STD_LOGIC;
    in1 : IN STD_LOGIC;
    ini : IN STD_LOGIC;
    outi_2 : IN STD_LOGIC;
    event_event101_td_2 : IN STD_LOGIC;
    event_event123_td_2 : IN STD_LOGIC;
    Bot1 : OUT STD_LOGIC;
    movei_2 : OUT STD_LOGIC;
    Pecas2 : OUT INTEGER RANGE 0 TO 3;
    out_evt_event104_td_1 : OUT STD_LOGIC;
    out_evt_event120_td_3 : OUT STD_LOGIC;
    Enable : IN STD_LOGIC;
    Reset : IN STD_LOGIC
);
End Lab3_P8_Corrigido_ASYNC_TD_2;

Architecture Structural OF Lab3_P8_Corrigido_ASYNC_TD_2 IS

    Signal p_8: INTEGER RANGE 0 TO 3 := 0;
    Signal p_89_4: INTEGER RANGE 0 TO 3 := 0;
    Signal p_89_6: INTEGER RANGE 0 TO 3 := 0;
    Signal p_89_43: INTEGER RANGE 0 TO 3 := 3;
    Signal p_89_46: INTEGER RANGE 0 TO 3 := 0;
    Signal p_89_69: INTEGER RANGE 0 TO 3 := 0;
    Signal p_89_72: INTEGER RANGE 0 TO 1 := 0;
    Signal p_89_74: INTEGER RANGE 0 TO 1 := 1;
    Signal p_89_78: INTEGER RANGE 0 TO 3 := 1;

    Signal prev_ini: STD_LOGIC := '0';
    Signal prev_outi_2: STD_LOGIC := '0';

    Signal event_ini: STD_LOGIC := '0';
    Signal event_outi_2: STD_LOGIC := '0';

    Signal s_Bot1 : STD_LOGIC := '0';
    Signal s_movei_2 : STD_LOGIC := '0';
    Signal s_Pecas2 : INTEGER RANGE 0 TO 3 := 0;

    -- Array implementation:

Begin
    -- Selected array items:

    proc_in_events: PROCESS( Clk, Enable ) IS
    Begin
      If falling_edge(Clk) Then
        If Reset = '0' AND Enable = '1' Then
          If (prev_ini = '0') and (ini = '1')
            Then event_ini <= '1';
            Else event_ini <= '0';
          End If;
          If (prev_outi_2 = '0') and (outi_2 = '1')
            Then event_outi_2 <= '1';
            Else event_outi_2 <= '0';
          End If;
        End If;
        prev_ini <= ini;
        prev_outi_2 <= outi_2;
      End If;
    End PROCESS;


    proc_transitions: PROCESS( Clk, Enable, Reset ) IS
      Variable p_8_add, p_8_avail : INTEGER RANGE 0 to 3;
      Variable p_89_4_add, p_89_4_avail : INTEGER RANGE 0 to 3;
      Variable p_89_6_add, p_89_6_avail : INTEGER RANGE 0 to 3;
      Variable p_89_43_add, p_89_43_avail : INTEGER RANGE 0 to 3;
      Variable p_89_46_add, p_89_46_avail : INTEGER RANGE 0 to 3;
      Variable p_89_69_add, p_89_69_avail : INTEGER RANGE 0 to 3;
      Variable p_89_72_add, p_89_72_avail : INTEGER RANGE 0 to 1;
      Variable p_89_74_add, p_89_74_avail : INTEGER RANGE 0 to 1;
      Variable p_89_78_add, p_89_78_avail : INTEGER RANGE 0 to 3;
    Begin
      If Reset = '1' Then
          p_8 <= 0;
          p_89_4 <= 0;
          p_89_6 <= 0;
          p_89_43 <= 3;
          p_89_46 <= 0;
          p_89_69 <= 0;
          p_89_72 <= 0;
          p_89_74 <= 1;
          p_89_78 <= 1;
      Elsif rising_edge(Clk) Then
        If Enable = '1' Then
          p_8_avail := p_8;
          p_8_add := 0;   -- pl_8;
          p_89_4_avail := p_89_4;
          p_89_4_add := 0;   -- pl_4_4;
          p_89_6_avail := p_89_6;
          p_89_6_add := 0;   -- Processar Peca_2;
          p_89_43_avail := p_89_43;
          p_89_43_add := 0;   -- Pecas2;
          p_89_46_avail := p_89_46;
          p_89_46_add := 0;   -- Buffer_2;
          p_89_69_avail := p_89_69;
          p_89_69_add := 0;   -- Move_2;
          p_89_72_avail := p_89_72;
          p_89_72_add := 0;   -- Parado & Ocupado_2;
          p_89_74_avail := p_89_74;
          p_89_74_add := 0;   -- Parado & Livre_2;
          p_89_78_avail := p_89_78;
          p_89_78_add := 0;   -- pl_78_2;

          out_evt_event104_td_1 <= '0';
          out_evt_event120_td_3 <= '0';

          -- Transition 89_10 - OUT1_2
          If (p_89_69_avail >= 1) and
             (event_outi_2 = '1') and 
             (conv_integer(outi_2) = 1) -- guard expr 
          Then
              p_89_69_avail := p_89_69_avail - 1;    -- Move_2
              p_89_4_add := p_89_4_add + 1;   -- pl_4_4
              p_89_72_add := p_89_72_add + 1;   -- Parado & Ocupado_2
          End If;

          -- Transition 89_11 - tr_11_4
          If (p_89_4_avail >= 1) and
             (p_89_78_avail >= 1) and 
             (conv_integer(outi_2) = 1) -- guard expr 
          Then
              p_89_4_avail := p_89_4_avail - 1;    -- pl_4_4
              p_89_78_avail := p_89_78_avail - 1;    -- pl_78_2
              p_89_6_add := p_89_6_add + 1;   -- Processar Peca_2
          End If;

          -- Transition 89_12 - tr_12_4
          If (p_89_72_avail >= 1) and
             (p_89_6_avail >= 1) and 
             (conv_integer(outi_2) = 0) -- guard expr 
          Then
              p_89_72_avail := p_89_72_avail - 1;    -- Parado & Ocupado_2
              p_89_6_avail := p_89_6_avail - 1;    -- Processar Peca_2
              p_89_43_add := p_89_43_add + 1;   -- Pecas2
              p_89_74_add := p_89_74_add + 1;   -- Parado & Livre_2
              out_evt_event120_td_3 <= '1';
          End If;

          -- Transition 89_39 - tr_39_2
          If (p_89_43_avail >= 1) and
             (p_8_avail >= 1) and
             (event_ini = '1')
          Then
              p_89_43_avail := p_89_43_avail - 1;    -- Pecas2
              p_8_avail := p_8_avail - 1;    -- pl_8
              p_89_46_add := p_89_46_add + 1;   -- Buffer_2
          End If;

          -- Transition 89_67 - tr_67_2
          If (p_89_46_avail >= 1) and
             (p_89_74_avail >= 1)
          Then
              p_89_46_avail := p_89_46_avail - 1;    -- Buffer_2
              p_89_74_avail := p_89_74_avail - 1;    -- Parado & Livre_2
              p_89_69_add := p_89_69_add + 1;   -- Move_2
              out_evt_event104_td_1 <= '1';
          End If;

          -- Transition 98 - tr_121
          If TRUE and
             (event_event101_td_2 = '1')
          Then
              p_8_add := p_8_add + 1;   -- pl_8
          End If;

          -- Transition 118 - tr_67_31
          If TRUE and
             (event_event123_td_2 = '1')
          Then
              p_89_78_add := p_89_78_add + 1;   -- pl_78_2
          End If;

          -- Calculate final place marking:
          p_8 <= p_8_avail + p_8_add;
          p_89_4 <= p_89_4_avail + p_89_4_add;
          p_89_6 <= p_89_6_avail + p_89_6_add;
          p_89_43 <= p_89_43_avail + p_89_43_add;
          p_89_46 <= p_89_46_avail + p_89_46_add;
          p_89_69 <= p_89_69_avail + p_89_69_add;
          p_89_72 <= p_89_72_avail + p_89_72_add;
          p_89_74 <= p_89_74_avail + p_89_74_add;
          p_89_78 <= p_89_78_avail + p_89_78_add;

          -- Apply output events to ouput signals:

          -- Calculate transition-action-output final values:
        End If;
      End If;
    End PROCESS;


    proc_place_outputs: PROCESS( Clk, Enable ) IS
    Variable exp_res, new_value: Integer;
    Begin
      If rising_edge(Clk) Then
        If Reset='1' Then
          s_Bot1 <= '0';
          s_movei_2 <= '0';
          s_Pecas2 <= 0;

        Elsif Enable='1' Then

          -- Signal Bot1 default value:
          new_value := 0;

          -- Bot1 action on place pl_8(p_8)
          If p_8 > 0 Then
            exp_res := 1;
            If (TRUE)
              Then new_value := exp_res;
            End If;
          End If;

          -- Store Bot1 and check result range:
          If new_value < 0 Then s_Bot1 <= '0';
            Elsif new_value > 1 Then s_Bot1 <= '1';
            Else s_Bot1 <= conv_std_logic_vector(new_value,1)(0);
          End If;

          -- Signal movei_2 default value:
          new_value := 0;

          -- movei_2 action on place Move_2(p_89_69)
          If p_89_69 > 0 Then
            exp_res := 1;
            If (TRUE)
              Then new_value := exp_res;
            End If;
          End If;

          -- Store movei_2 and check result range:
          If new_value < 0 Then s_movei_2 <= '0';
            Elsif new_value > 1 Then s_movei_2 <= '1';
            Else s_movei_2 <= conv_std_logic_vector(new_value,1)(0);
          End If;

          -- Signal Pecas2 default value:
          new_value := 0;

          -- Pecas2 action on place Pecas2(p_89_43)
          If p_89_43 > 0 Then
            exp_res := 3 - p_89_43;
            If (TRUE)
              Then new_value := exp_res;
            End If;
          End If;

          -- Store Pecas2 and check result range:
          If new_value < 0 Then s_Pecas2 <= 0;
            Elsif new_value > 3 Then s_Pecas2 <= 3;
            Else s_Pecas2 <= new_value;
          End If;

        End If;
      End If;
    End PROCESS;

    Bot1 <= s_Bot1;
    movei_2 <= s_movei_2;
    Pecas2 <= s_Pecas2;

End Structural;
